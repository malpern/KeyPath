## Scripts/lab/pico-hid-fixture/targets/waveshare-esp32-s3-touch-lcd-1.69/main/Kconfig.projbuild
```kconfig
menu "KeyPath HID fixture"

    config KEYPATH_FIXTURE_BOARD_REVISION
        int "Waveshare board hardware revision"
        range 1 2
        default 2
        help
            Select 2 for current boards. Revision 1 used GPIO33 for the buzzer;
            revision 2 uses GPIO42. The LCD, touch, and native USB pins are shared.

    config KEYPATH_FIXTURE_HTTP_PORT
        int "Fixture HTTP port"
        range 1024 65535
        default 8080

    config KEYPATH_FIXTURE_BRIGHTNESS
        int "Display brightness percent"
        range 10 100
        default 85

    config KEYPATH_FIXTURE_SOUND
        bool "Enable state-change tones"
        default y

    config KEYPATH_FIXTURE_REDUCED_MOTION
        bool "Reduce display motion"
        default n
        help
            Keep state, color, and progress feedback while disabling orbital
            movement, pulsing geometry, and the completion particle flourish.

    config KEYPATH_FIXTURE_BOOT_SPLASH
        bool "Enable the Hacker Dojo boot splash"
        default y
        help
            Show the short display-native identity splash before the live
            fixture state. The splash renderer uses bounded redraw regions,
            and OTA validation requires its display heartbeat to complete.

endmenu
```
